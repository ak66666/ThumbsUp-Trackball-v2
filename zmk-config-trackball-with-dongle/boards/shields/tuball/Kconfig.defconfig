## zmk-config-trackball-with-dongle/boards/shields/tuball/Kconfig.defconfig
```kconfig
if SHIELD_TUBALL_DONGLE || SHIELD_TUBALL_LEFT || SHIELD_TUBALL_RIGHT
config ZMK_SPLIT 
    default y
config ZMK_POINTING
    default y
endif

if SHIELD_TUBALL_DONGLE
config ZMK_KEYBOARD_NAME
	default "tuball"
config ZMK_SPLIT_ROLE_CENTRAL
	default y
endif

if SHIELD_TUBALL_RIGHT
config SPI
    default y
endif
```

## zmk-config-trackball-with-dongle/boards/shields/tuball/Kconfig.shield
```kconfig
# No whitespace after the comma or in your part name!

config SHIELD_TUBALL_LEFT
    def_bool $(shields_list_contains,tuball_left)

config SHIELD_TUBALL_RIGHT
    def_bool $(shields_list_contains,tuball_right)

config SHIELD_TUBALL_DONGLE
	def_bool $(shields_list_contains,tuball_dongle)
```

## zmk-config-trackball-with-dongle/config/west.yml
```yaml
manifest:
  remotes:
    - name: zmkfirmware
      url-base: https://github.com/zmkfirmware
    - name: badjeff
      url-base: https://github.com/badjeff
    - name: nuovotaka
      url-base: https://github.com/nuovotaka

  projects:
    - name: zmk
      remote: zmkfirmware
      revision: main
      import: app/west.yml
    - name: zmk-pmw3610-driver
      remote: badjeff
      revision: main
    - name: zmk-pointing-acceleration-alpha
      remote: nuovotaka
      revision: main

  self:
    path: config
```
